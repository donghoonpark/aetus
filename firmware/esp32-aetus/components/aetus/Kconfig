## firmware/esp32-aetus/components/aetus/Kconfig
```kconfig
menu "AETUS upload stack"

config AETUS_MAX_METRICS
    int "Maximum metrics per telemetry event"
    default 32
    range 4 32
    help
        Maximum number of Metric entries accepted in one telemetry event.
        The first four entries are stored inline in aetus_telemetry_t; entries
        after that are allocated on the FreeRTOS heap. The upper bound remains
        compile-time limited because nanopb uses a fixed repeated-field array
        while encoding.

config AETUS_SIGNAL_SAMPLES_MAX
    int "Maximum signal frame sample bytes"
    default 2400
    range 1 8192
    help
        Maximum raw sample bytes accepted in one signal frame. Samples are
        borrowed by aetus_signal_frame_t and copied into a heap-allocated
        buffer when enqueued.

config AETUS_ENCODE_BUFFER_BYTES
    int "AETUS protobuf encode buffer bytes"
    default 4096
    range 1024 16384
    help
        Stack buffer used by the uploader task to hold one encoded protobuf
        request body. It must be larger than AETUS_SIGNAL_SAMPLES_MAX plus
        protobuf envelope and channel metadata overhead.

config AETUS_TASK_STACK_BYTES
    int "AETUS uploader task stack bytes"
    default 12288
    range 8192 24576
    help
        Stack size for the uploader task. The task owns the encode buffer and
        one queue item while posting to HTTP.

config AETUS_QUEUE_ITEM_MAX_BYTES
    int "Maximum AETUS queue item bytes"
    default 1024
    range 512 4096
    help
        Compile-time guard for the size of one FreeRTOS queue item. Signal
        frame sample bytes are held by the sample pool, so queue slots should
        stay small even when AETUS_SIGNAL_SAMPLES_MAX grows.

config AETUS_ISR_SAFE_ENQUEUE
    bool "ISR-safe telemetry and status enqueue"
    default y
    help
        Enable aetus_enqueue_telemetry_from_isr() and
        aetus_enqueue_status_from_isr(). When enabled, a global buffer
        (sizeof(aetus_queue_item_t) bytes in BSS) is reserved so the
        enqueue path never allocates the item on the calling task's stack,
        making it safe to call from an interrupt even when interrupting
        a small-stack task such as the IDLE task.

        Disable this option to reclaim the global buffer when the ISR-safe
        API is not used.

config AETUS_TEST_HOOKS
    bool "AETUS internal test hooks"
    default n
    help
        Expose internal ownership helpers for ESP-IDF/QEMU contract tests.
        Keep this disabled in production firmware.

config AETUS_TEST_NO_NETWORK
    bool "AETUS test build without WiFi/HTTP backends"
    default n
    depends on AETUS_TEST_HOOKS
    help
        Build the uploader runtime against test hooks only, without linking the
        ESP WiFi/PHY/HTTP backend. This keeps QEMU ownership tests focused on
        queue, encode, and release behavior while avoiding unsupported radio
        startup paths in emulation.

endmenu
```

## firmware/esp32-aetus/examples/cpp-basic/sdkconfig.defaults
```kconfig
CONFIG_BOOTLOADER_LOG_LEVEL_WARN=y
CONFIG_LOG_DEFAULT_LEVEL_INFO=y
CONFIG_ESP_MAIN_TASK_STACK_SIZE=8192
CONFIG_ESPTOOLPY_FLASHSIZE_4MB=y
CONFIG_ESPTOOLPY_FLASHSIZE="4MB"
CONFIG_ESP_WIFI_STATIC_RX_BUFFER_NUM=8
CONFIG_ESP_WIFI_DYNAMIC_RX_BUFFER_NUM=16
CONFIG_BT_ENABLED=y
CONFIG_BT_NIMBLE_ENABLED=y
CONFIG_BT_NIMBLE_MAX_CONNECTIONS=1
CONFIG_BT_NIMBLE_MAX_BONDS=1
CONFIG_BT_NIMBLE_MAX_CCCDS=1
CONFIG_BT_NIMBLE_ROLE_CENTRAL=n
CONFIG_BT_NIMBLE_ROLE_OBSERVER=n
CONFIG_PARTITION_TABLE_CUSTOM=y
CONFIG_PARTITION_TABLE_CUSTOM_FILENAME="partitions.csv"
CONFIG_PARTITION_TABLE_FILENAME="partitions.csv"
```

## firmware/esp32-qemu-telemetry/sdkconfig.defaults
```kconfig
CONFIG_BOOTLOADER_LOG_LEVEL_WARN=y
CONFIG_LOG_DEFAULT_LEVEL_INFO=y
CONFIG_ESP_SYSTEM_PANIC_PRINT_REBOOT=y
```

## firmware/esp32c5-upload-smoke/sdkconfig.defaults
```kconfig
CONFIG_BOOTLOADER_LOG_LEVEL_WARN=y
CONFIG_LOG_DEFAULT_LEVEL_INFO=y
CONFIG_ESP_MAIN_TASK_STACK_SIZE=8192
CONFIG_ESP_WIFI_STATIC_RX_BUFFER_NUM=8
CONFIG_ESP_WIFI_DYNAMIC_RX_BUFFER_NUM=16
CONFIG_LWIP_SO_RCVBUF=y
CONFIG_PARTITION_TABLE_CUSTOM=y
CONFIG_PARTITION_TABLE_CUSTOM_FILENAME="partitions.csv"
CONFIG_PARTITION_TABLE_FILENAME="partitions.csv"
```

## firmware/examples/cpp-light-sleep/sdkconfig.defaults
```kconfig
CONFIG_BOOTLOADER_LOG_LEVEL_WARN=y
CONFIG_LOG_DEFAULT_LEVEL_INFO=y
CONFIG_ESP_MAIN_TASK_STACK_SIZE=8192
CONFIG_ESPTOOLPY_FLASHSIZE_4MB=y
CONFIG_ESPTOOLPY_FLASHSIZE="4MB"
CONFIG_ESP_DEFAULT_CPU_FREQ_MHZ_240=y
CONFIG_ESP_DEFAULT_CPU_FREQ_MHZ=240
CONFIG_PM_ENABLE=y
CONFIG_PM_LIGHT_SLEEP_CALLBACKS=y
CONFIG_PM_SLP_IRAM_OPT=y
CONFIG_FREERTOS_USE_TICKLESS_IDLE=y
CONFIG_FREERTOS_IDLE_TIME_BEFORE_SLEEP=3
CONFIG_ESP_WIFI_STATIC_RX_BUFFER_NUM=8
CONFIG_ESP_WIFI_DYNAMIC_RX_BUFFER_NUM=16
CONFIG_BT_ENABLED=y
CONFIG_BT_NIMBLE_ENABLED=y
CONFIG_BT_NIMBLE_MAX_CONNECTIONS=1
CONFIG_BT_NIMBLE_MAX_BONDS=1
CONFIG_BT_NIMBLE_MAX_CCCDS=1
CONFIG_BT_NIMBLE_ROLE_CENTRAL=n
CONFIG_BT_NIMBLE_ROLE_OBSERVER=n
CONFIG_PARTITION_TABLE_CUSTOM=y
CONFIG_PARTITION_TABLE_CUSTOM_FILENAME="partitions.csv"
CONFIG_PARTITION_TABLE_FILENAME="partitions.csv"
```

## firmware/test-apps/cpp-literal-limit-negative/sdkconfig.defaults
```kconfig
CONFIG_BOOTLOADER_LOG_LEVEL_WARN=y
CONFIG_LOG_DEFAULT_LEVEL_INFO=y
CONFIG_ESPTOOLPY_FLASHSIZE_4MB=y
CONFIG_ESPTOOLPY_FLASHSIZE="4MB"
```

## firmware/test-apps/esp32c5-isr-enqueue/sdkconfig.defaults
```kconfig
CONFIG_BOOTLOADER_LOG_LEVEL_WARN=y
CONFIG_LOG_DEFAULT_LEVEL_INFO=y
CONFIG_ESP_MAIN_TASK_STACK_SIZE=8192
CONFIG_ESPTOOLPY_FLASHSIZE_4MB=y
CONFIG_ESPTOOLPY_FLASHSIZE="4MB"
CONFIG_PARTITION_TABLE_CUSTOM=y
CONFIG_PARTITION_TABLE_CUSTOM_FILENAME="partitions.csv"
CONFIG_PARTITION_TABLE_FILENAME="partitions.csv"
```

## firmware/test-apps/qemu-runtime-contract/sdkconfig.defaults
```kconfig
CONFIG_BOOTLOADER_LOG_LEVEL_INFO=y
CONFIG_LOG_DEFAULT_LEVEL_INFO=y
CONFIG_ESP_MAIN_TASK_STACK_SIZE=8192
CONFIG_AETUS_TEST_HOOKS=y
CONFIG_AETUS_TEST_NO_NETWORK=y
CONFIG_AETUS_TASK_STACK_BYTES=12288
CONFIG_AETUS_ENCODE_BUFFER_BYTES=4096
CONFIG_AETUS_SIGNAL_SAMPLES_MAX=2400
CONFIG_AETUS_MAX_METRICS=32
```

## firmware/test-apps/qemu-telemetry-heap/sdkconfig.defaults
```kconfig
CONFIG_BOOTLOADER_LOG_LEVEL_INFO=y
CONFIG_LOG_DEFAULT_LEVEL_INFO=y
CONFIG_ESP_MAIN_TASK_STACK_SIZE=8192
```
